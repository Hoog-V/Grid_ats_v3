## fw_mcxn947/boards/arm/ats_mcxn947/board.yml
```yaml
board:
  name: ats_mcxn947
  full_name: ATS-MCXN947
  vendor: nxp
  socs:
  - name: mcxn947
    variants:
    - name: qspi
      cpucluster: 'cpu0'
```
